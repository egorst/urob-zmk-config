## config/west.yml
```yaml
manifest:
  remotes:
    - name: egorst
      url-base: https://github.com/egorst
  projects:
    - name: zmk
      remote: egorst
      revision: v0.3
      import: app/west.yml
  self:
    path: config
```
