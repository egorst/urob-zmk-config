/*
 * Copyright (c) 2023 Andrei Gaevskii
 *
 * SPDX-License-Identifier: MIT
 */

#include <behaviors.dtsi>
#include <dt-bindings/zmk/keys.h>
#include <dt-bindings/zmk/bt.h>

&lt {
    quick-tap-ms = <200>;
};

&mt {
    quick-tap-ms = <200>;
};

/ {
    keymap {
        compatible = "zmk,keymap";

        default_layer {
            bindings = <
     &none  &none         &none         &none         &none         &none         &none           &none         &none         &none         &none         &none        &none  &none
            &none         &none         &none         &none         &none         &none           &none         &none         &none         &none         &none        &none
            &none         &none         &none         &none         &none         &none           &none         &none         &none         &none         &none        &none
                                        &none         &none         &none         &none           &none         &none         &none         &none
        };
    };
};
